## main/Kconfig.projbuild
```kconfig
menu "Agent Presence Device"

config WIFI_SSID
    string "Wi-Fi SSID"
    default ""

config WIFI_PASSWORD
    string "Wi-Fi password"
    default ""

endmenu
```
